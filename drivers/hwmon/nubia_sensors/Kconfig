## drivers/hwmon/nubia_sensors/Kconfig
```kconfig
################################################# SENROS START
menuconfig NUBIA_SENSORS
	tristate "NUBIA SENSORS ON"
	default n
	help
		nubia senor
if NUBIA_SENSORS
config FEATURE_NUBIA_SENSORS_LOG_ON
	tristate "NUBIA SENSORS LOG ON"
	depends on NUBIA_SENSORS
	default n
	help
		If you want to enable the sensor log,
		then choose this config
################################################# IR REMOTE START
config NUBIA_SENSORS_IR_REMOTE_I_THREE
	tristate "I_THREE device driver"
	depends on NUBIA_SENSORS
	default n
	help
	  If you say yes here you get support for UEI's
	  IR Remote control i_three

endif
```

## drivers/misc/mediatek/alsps/APDS9930-new/Kconfig
```kconfig
config MTK_APDS9930_NEW
	bool "APDS9930_NEW for MediaTek package"
	default n

config NUBIA_APDS9930_NEW_ALS_CONT_VALUE
	bool "Enable APDS9930_NEW als continuous value"
	default n
```

## drivers/misc/mediatek/fingerprint/Kconfig
```kconfig
config FINGERPRINT_GOODIX_GF_TEE
  bool FINGERPRINT_GOODIX_GF_TEE
  default n
  help
    Goodix Fingerprint chip GF516/GF318GF316M/GF516M/GF616M/GF318M TEE driver
config FINGERPRINT_GOODIX_GF616
  bool FINGERPRINT_GOODIX_GF616
  default n
  help
    Goodix Fingerprint chip GF616/GF516/GF316/GF318

config FINGERPRINT_GOODIX_GF516M
  bool FINGERPRINT_GOODIX_GF516M
  default n
  help
    Goodix Fingerprint chip GF316M/GF516M/GF616M/GF318M

config NUBIA_SEC_SPI0
	bool NUBIA_SEC_SPI0
	default n
	help
		fingerprint spi config : spi0 if y.
config FINGERPRINT_FPC_ISEE
    bool FINGERPRINT_FPC_ISEE
	default n
	help
	 This is fpc1022 fingerprints driver base on microtrust tee.
```

## drivers/misc/mediatek/nfc/Kconfig
```kconfig
menuconfig MTK_NFC
	tristate "NFC drivers"
	default n
	---help---
	  Say Y here for supporting NFC.

if MTK_NFC

config NFC_MT6605
	tristate "MediaTek NFC driver"
	default n

config NFC_MSR3110
	tristate "MSR3110 NFC driver"
	default n

endif # NFC

config BCM2079X_I2C
	tristate "BCM2079X NFC driver"
	depends on I2C
	default n
	---help---
	  Say yes if you want BCM20791 Near Field Communication driver.
	  This is for i2c connected version. If unsure, say N here.

	  To compile this driver as a module, choose m here. The module will
	  be called bcm2079x.
```

## drivers/misc/mediatek/sound/Kconfig
```kconfig
config MTK_SOUND_DRV
  bool CONFIG_MTK_SOUND_DRV
  default n
  help
    CONFIG_MTK_SOUND_DRV
config SND_SOC_AK4376
        tristate "SND_SOC_AK4376"
```
